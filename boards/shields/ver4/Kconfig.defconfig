## boards/shields/ver4/Kconfig.defconfig
```kconfig
if SHIELD_VER4_RIGHT

config ZMK_KEYBOARD_NAME
    default "ver4"

endif

if SHIELD_VER4_LEFT || SHIELD_VER4_RIGHT

config ZMK_SPLIT
    default y

endif
```

## boards/shields/ver4/Kconfig.shield
```kconfig
config SHIELD_VER4_LEFT
    def_bool $(shields_list_contains,ver4_left)
config SHIELD_VER4_RIGHT
    def_bool $(shields_list_contains,ver4_right)
```
